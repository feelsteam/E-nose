/************************************************************************************************************
 * @file    main.c
 * @brief   HT32F52367 (BM53A367A) 控制 SSD1309 OLED
 *          完全對應 Arduino SSD1309_test.ino 的硬體 SPI 接線
 *
 * ============================================================
 * variant.h 確認腳位：Arduino SPI = HT_SPI1 (PC11/PC8/PC9/PC10)
 *   SPI0_PORT  = HT_SPI1  (Arduino SPI 物件)
 *   SPI0_SCK   = PC11 D13 (HT_SPI1 SCK)
 *   SPI0_MOSI  = PC8  D11 (HT_SPI1 MOSI)
 *   SPI0_MISO  = PC9  D12 (HT_SPI1 MISO)
 *   SPI0_SEL   = PC10 D10 (HT_SPI1 SS)
 *
 * ============================================================
 * 硬體接線：
 *   OLED CS  -> D10 (PC10)  OLED SCL -> D13 (PC11)
 *   OLED SDA -> D11 (PC8)   OLED RES -> D8  (PA14)
 *   OLED DC  -> D9  (PA15)
 *
 * ============================================================
 * 【SPI_SEL_HARDWARE 說明】
 *   SOFTWARE SEL 模式下，只要 SS 腳位(PC10)未透過 AFIO 接到 SPI1，
 *   SPI1 內部的 SS 輸入會偵測到異常狀態 → Mode Fault (bit5) = 1
 *   → SCK 停止輸出 → RXBNE 永遠不被設定 → 無限等待。
 *
 *   解法：改用 SPI_SEL_HARDWARE + PC10 設 AFIO_FUN_SPI。
 *   SPI1 硬體在每個 byte 傳送時自動控制 PC10 (CS)：
 *     CS 拉低 → 8 個 SCK → CS 拉高。
 *   對 SSD1309 這類每 byte 都有獨立 CS 的協議完全正確。
 *   DC (PA15) 仍由 GPIO 手動控制，在 CS 拉低前設定好即可。
 ***********************************************************************************************************/

#include "ht32.h"
#include "ht32_board.h"

/* ==========================================================================
 * 【第一區】腳位定義
 *
 * Arduino: CS=D10, DC=D9, RES=D8, SCK=D13, MOSI=D11
 * ==========================================================================*/
/* DC, RES 仍為 GPIO — CS 改由 SPI1 硬體控制 */
#define OLED_DC_PORT    HT_GPIOA
#define OLED_DC_PIN     GPIO_PIN_15   /* D9  = PA15 */

#define OLED_RES_PORT   HT_GPIOA
#define OLED_RES_PIN    GPIO_PIN_14   /* D8  = PA14 */

/* variant.h 確認：Arduino SPI → HT_SPI1 */
#define OLED_SPI_PORT   HT_SPI1

/* ==========================================================================
 * 【第二區】GPIO 操作巨集
 * CS 不再需要巨集 (由 SPI1 硬體處理)
 * ==========================================================================*/
#define OLED_DC_CMD()  GPIO_WriteOutBits(OLED_DC_PORT,  OLED_DC_PIN,  RESET)
#define OLED_DC_DAT()  GPIO_WriteOutBits(OLED_DC_PORT,  OLED_DC_PIN,  SET)
#define OLED_RES_L()   GPIO_WriteOutBits(OLED_RES_PORT, OLED_RES_PIN, RESET)
#define OLED_RES_H()   GPIO_WriteOutBits(OLED_RES_PORT, OLED_RES_PIN, SET)

/* ==========================================================================
 * 【第三區】OLED 尺寸常數
 * ==========================================================================*/
#define OLED_WIDTH      128
#define OLED_PAGES      8

/* ==========================================================================
 * 【第四區】字型資料 (8x8 ASCII 0x20~0x7E)
 * ==========================================================================*/
static const u8 Font8x8[][8] = {
  {0x00,0x00,0x00,0x00,0x00,0x00,0x00,0x00}, /* 0x20   */
  {0x00,0x00,0x5F,0x00,0x00,0x00,0x00,0x00}, /* 0x21 ! */
  {0x00,0x07,0x00,0x07,0x00,0x00,0x00,0x00}, /* 0x22 " */
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  {0x08,0x04,0x08,0x10,0x08,0x00,0x00,0x00}, /* 0x7E ~ */
};

/* ==========================================================================
 * 【第五區】函數原型
 * ==========================================================================*/
void Hardware_Init(void);
void SPI_PollSendByte(u8 data);
void OLED_WriteCmd(u8 cmd);
void OLED_WriteData(u8 data);
void OLED_Init(void);
void OLED_Clear(void);
void OLED_Fill(u8 val);
void OLED_SetCursor(u8 page, u8 col);
void OLED_DrawChar(u8 page, u8 col, char ch);
void OLED_DrawString(u8 page, u8 col, const char *str);
void OLED_DrawLine(u8 page);
void Delay_ms(u32 ms);

/* ==========================================================================
 * 【第六區】主程式 (對應 Arduino setup() + loop())
 * ==========================================================================*/
int main(void)
{
  Hardware_Init();

  /* ---- 對應 Arduino setup() ---- */
  OLED_Init();

  /* ---- 對應 Arduino loop() ---- */
  while (1)
  {
    /* 測試 1：全亮 (0xAA 條紋) */
    {
      u8 page, col;
      for (page = 0; page < OLED_PAGES; page++) {
        OLED_SetCursor(page, 0);
        for (col = 0; col < OLED_WIDTH; col++)
          OLED_WriteData(0xAA);
      }
    }
    Delay_ms(1500);

    /* 測試 2：反轉條紋 (0x55) */
    {
      u8 page, col;
      for (page = 0; page < OLED_PAGES; page++) {
        OLED_SetCursor(page, 0);
        for (col = 0; col < OLED_WIDTH; col++)
          OLED_WriteData(0x55);
      }
    }
    Delay_ms(1500);
  }
}

/* ==========================================================================
 * 【第七區】硬體初始化
 *
 * 對應 Arduino:
 *   SPI.begin()                              → HT_SPI1 初始化
 *   SPI.beginTransaction(SPISettings(8MHz,   → ClockPrescaler=8 (60M/8=7.5M≈8MHz)
 *                         MSBFIRST,           → SPI_FIRSTBIT_MSB
 *                         SPI_MODE0))         → CPOL=LOW, CPHA=FIRST
 *   pinMode(OLED_CS, OUTPUT)                 → PC10 GPIO Output
 *   pinMode(OLED_DC, OUTPUT)                 → PA15 GPIO Output
 *   pinMode(OLED_RES, OUTPUT)                → PA14 GPIO Output
 *   digitalWrite(OLED_CS, HIGH)              → OLED_CS_H()
 *
 * 關鍵：variant.h 確認 Arduino SPI = HT_SPI1，PC11/PC8/PC9 透過
 *       AFIO_FUN_SPI 映射到 SPI1。CS (PC10) 維持 GPIO 手動控制。
 *
 * SPI_SEL_SOFTWARE + SPI_SoftwareSELCmd(ACTIVE)：
 *   CS 由 GPIO 手動控制（完全複製 Arduino 行為），
 *   SPI_SoftwareSELCmd 只是啟動 SPI1 內部時鐘輸出許可。
 *   因 PC10 已被 GPIO 拉高，SPI1 不會發生 Mode Fault。
 * ==========================================================================*/
void Hardware_Init(void)
{
  SPI_InitTypeDef SPI_InitStructure;
  CKCU_PeripClockConfig_TypeDef CKCUClock = {{0}};

  /* 開啟周邊時鐘 */
  CKCUClock.Bit.SPI1 = 1;
  CKCUClock.Bit.PA   = 1;   /* DC (PA15), RES (PA14) */
  CKCUClock.Bit.PC   = 1;   /* SCK(PC11), MOSI(PC8), MISO(PC9), SS(PC10) */
  CKCUClock.Bit.AFIO = 1;
  CKCU_PeripClockConfig(CKCUClock, ENABLE);

  /* SPI1 全部四個腳位均設 AFIO_FUN_SPI ─ 包含 SS (PC10)！
   * 若 PC10 是 GPIO 而非 SPI_AFIO，SPI1 內部 SS 輸入偵測異常
   * → Mode Fault (SR bit5=1) → SCK 停止 → RXBNE 永遠不被設定  */
  AFIO_GPxConfig(GPIO_PC, AFIO_PIN_11, AFIO_FUN_SPI); /* SCK  D13 */
  AFIO_GPxConfig(GPIO_PC, AFIO_PIN_8,  AFIO_FUN_SPI); /* MOSI D11 */
  AFIO_GPxConfig(GPIO_PC, AFIO_PIN_9,  AFIO_FUN_SPI); /* MISO D12 */
  AFIO_GPxConfig(GPIO_PC, AFIO_PIN_10, AFIO_FUN_SPI); /* SS   D10 ← 關鍵！消除 MF */
  GPIO_PullResistorConfig(HT_GPIOC, GPIO_PIN_9, GPIO_PR_UP); /* MISO 上拉 */

  /* DC (PA15), RES (PA14) → GPIO 輸出 */
  AFIO_GPxConfig(GPIO_PA, AFIO_PIN_15, AFIO_FUN_GPIO);
  AFIO_GPxConfig(GPIO_PA, AFIO_PIN_14, AFIO_FUN_GPIO);
  GPIO_DirectionConfig(OLED_DC_PORT,  OLED_DC_PIN,  GPIO_DIR_OUT);
  GPIO_DirectionConfig(OLED_RES_PORT, OLED_RES_PIN, GPIO_DIR_OUT);
  OLED_DC_DAT();
  OLED_RES_H();

  /* SPI1 初始化：HARDWARE SEL，讓 SPI1 自動控制 PC10 */
  SPI_InitStructure.SPI_Mode               = SPI_MASTER;
  SPI_InitStructure.SPI_FIFO               = SPI_FIFO_DISABLE;
  SPI_InitStructure.SPI_DataLength         = SPI_DATALENGTH_8;
  SPI_InitStructure.SPI_SELMode            = SPI_SEL_HARDWARE; /* ← 消除 MF 的關鍵 */
  SPI_InitStructure.SPI_SELPolarity        = SPI_SELPOLARITY_LOW;
  SPI_InitStructure.SPI_CPOL             = SPI_CPOL_LOW;       /* SPI Mode 0 */
  SPI_InitStructure.SPI_CPHA             = SPI_CPHA_FIRST;
  SPI_InitStructure.SPI_FirstBit         = SPI_FIRSTBIT_MSB;
  SPI_InitStructure.SPI_RxFIFOTriggerLevel = 0;
  SPI_InitStructure.SPI_TxFIFOTriggerLevel = 0;
  SPI_InitStructure.SPI_ClockPrescaler   = 8;                  /* 60MHz/8 = 7.5MHz */
  SPI_Init(OLED_SPI_PORT, &SPI_InitStructure);

  /* 啟用硬體 SEL 輸出（SPI1 自動驅動 PC10） */
  SPI_SELOutputCmd(OLED_SPI_PORT, ENABLE);
  SPI_Cmd(OLED_SPI_PORT, ENABLE);
}

/* ==========================================================================
 * 【第八區】SPI 輪詢傳送
 *
 * 對應 Arduino: SPI.transfer(data)
 *
 * HT32 SPI 標準輪詢流程：
 *   1. 等待 TXBE (TX Buffer 空) → 確保可寫入
 *   2. 寫入資料 → SPI1 開始傳輸（PC11 SCK 開始振盪）
 *   3. 等待 RXBNE (全雙工完成)
 *   4. 假讀取，清除 RXBNE
 * ==========================================================================*/
void SPI_PollSendByte(u8 data)
{
  while (!SPI_GetFlagStatus(OLED_SPI_PORT, SPI_FLAG_TXBE));
  SPI_SendData(OLED_SPI_PORT, data);
  while (!SPI_GetFlagStatus(OLED_SPI_PORT, SPI_FLAG_RXBNE));
  SPI_ReceiveData(OLED_SPI_PORT);
}

/* ==========================================================================
 * 【第九區】OLED 指令/資料寫入
 *
 * HARDWARE SEL 模式：CS 由 SPI1 硬體自動控制
 * 時序：DC 設好 → 寫入 DR → SPI1 自動：CS↓ → 8 SCK → CS↑
 *
 * 對應 Arduino:
 *   sendCommand: DC=LOW,  CS=LOW, transfer, CS=HIGH
 *   sendData:    DC=HIGH, CS=LOW, transfer, CS=HIGH
 * ==========================================================================*/
void OLED_WriteCmd(u8 cmd)
{
  OLED_DC_CMD();          /* DC = LOW (指令) — 在 CS 拉低前設定 */
  SPI_PollSendByte(cmd);  /* SPI1 自動: CS↓ → 8 CLK → CS↑ */
}

void OLED_WriteData(u8 data)
{
  OLED_DC_DAT();           /* DC = HIGH (資料) — 在 CS 拉低前設定 */
  SPI_PollSendByte(data);  /* SPI1 自動: CS↓ → 8 CLK → CS↑ */
}

/* ==========================================================================
 * 【第十區】SSD1309 初始化 (對應 Arduino setup() 中的 sendCommand 序列)
 * ==========================================================================*/
void OLED_Init(void)
{
  /* 硬體重置 (對應 Arduino reset 序列) */
  OLED_RES_H(); Delay_ms(1);
  OLED_RES_L(); Delay_ms(1);   /* LOW 至少 3us，這裡給 1ms 確保穩定 */
  OLED_RES_H(); Delay_ms(1);

  /* 初始化指令序列 (完全對應 Arduino SSD1309_test.ino setup()) */
  OLED_WriteCmd(0xAE); /* Display OFF (Sleep mode) */

  OLED_WriteCmd(0x20); /* Set Memory Addressing Mode */
  OLED_WriteCmd(0x00); /* 0x00 = Horizontal Addressing Mode (同 Arduino) */

  OLED_WriteCmd(0x81); /* Set Contrast */
  OLED_WriteCmd(0x7F); /* Contrast = 0x7F */

  OLED_WriteCmd(0xA6); /* Normal Display (1=ON, 0=OFF) */

  OLED_WriteCmd(0xAF); /* Display ON */

  /* 清除螢幕 (對應 Arduino setup() 中的 1024 bytes 填 0x00) */
  OLED_WriteCmd(0x21); /* Set Column Range */
  OLED_WriteCmd(0x00); /* Start Column = 0 */
  OLED_WriteCmd(0x7F); /* End Column = 127 */
  OLED_WriteCmd(0x22); /* Set Page Range */
  OLED_WriteCmd(0x00); /* Start Page = 0 */
  OLED_WriteCmd(0x07); /* End Page = 7 */
  OLED_Clear();
}

/* ==========================================================================
 * 【第十一區】顯示工具函數
 * ==========================================================================*/
void OLED_SetCursor(u8 page, u8 col)
{
  /* Horizontal Addressing Mode：需要先設定 Column 和 Page 範圍後再寫資料 */
  /* 在水平模式下，用 0x21/0x22 設定起始位置 */
  OLED_WriteCmd(0x21);
  OLED_WriteCmd(col);
  OLED_WriteCmd(0x7F);
  OLED_WriteCmd(0x22);
  OLED_WriteCmd(page);
  OLED_WriteCmd(0x07);
}

void OLED_Fill(u8 val)
{
  /* 對應 Arduino: for (int i = 0; i < 1024; i++) sendData(val); */
  u16 i;
  OLED_WriteCmd(0x21); OLED_WriteCmd(0x00); OLED_WriteCmd(0x7F);
  OLED_WriteCmd(0x22); OLED_WriteCmd(0x00); OLED_WriteCmd(0x07);
  for (i = 0; i < 1024; i++)
    OLED_WriteData(val);
}

void OLED_Clear(void) { OLED_Fill(0x00); }

void OLED_DrawChar(u8 page, u8 col, char ch)
{
  u8 i;
  if (ch < 0x20 || ch > 0x7E) ch = ' ';
  OLED_SetCursor(page, col);
  for (i = 0; i < 8; i++)
    OLED_WriteData(Font8x8[ch - 0x20][i]);
}

void OLED_DrawString(u8 page, u8 col, const char *str)
{
  while (*str) {
    if (col + 8 > OLED_WIDTH) break;
    OLED_DrawChar(page, col, *str++);
    col += 8;
  }
}

void OLED_DrawLine(u8 page)
{
  u8 col;
  OLED_SetCursor(page, 0);
  for (col = 0; col < OLED_WIDTH; col++)
    OLED_WriteData(0xFF);
}

/* ==========================================================================
 * 【第十二區】延遲函數 (對應 Arduino delay())
 * ==========================================================================*/
void Delay_ms(u32 ms)
{
  volatile u32 i;
  while (ms--)
    for (i = 0; i < 12000; i++);
}